AUTOSAR XML (schema 00046)
package /PortInterfaces
  17 x sender receiver interface:
    SRI_LightLevel  # SW requirements: SWREQ_ODD_001.
      data illuminanceLux: type=float32
    SRI_RgbIn  # SW requirements: SWREQ_SEN_001.
      data rgbFrameId: type=uint32
      data rgbTimestampMs: type=uint32
    SRI_RGBFrameReady  # SW requirements: SWREQ_SEN_001, SWREQ_SEN_004.
      data rgbFrameId: type=sint32
      data rgbTimestampMs: type=uint32
    SRI_IRFrameReady  # SW requirements: SWREQ_SEN_003, SWREQ_SEN_004, SWREQ_SEN_007.
      data irFrameId: type=sint32
      data irTimestampMs: type=uint32
    SRI_AmbientTemp  # SW requirements: SWREQ_ODD_001.
      data temperatureDegC: type=float32
      data humidityPercent: type=float32
    SRI_FusedDataReady  # SW requirements: SWREQ_SEN_004, SWREQ_ALG_001, SWREQ_SEN_007.
      data fusedDataId: type=uint32
      data syncTimestampMs: type=uint32
    SRI_DetectionResult  # SW requirements: SWREQ_ALG_005, SWREQ_WRN_001, SWREQ_WRN_004, SWREQ_SEN_007.
      10 x data:
        tigerDetected: type=boolean
        confidence: type=float32
        bboxX: type=uint32
        bboxY: type=uint32
        bboxW: type=uint32
        bboxH: type=uint32
        timestampMs: type=uint32
        bearingDeg: type=float32
        distanceM: type=float32
        resultValid: type=boolean
    SRI_WarningCommand  # SW requirements: SWREQ_WRN_001, SWREQ_WRN_002, SWREQ_WRN_003, SWREQ_WRN_004, SWREQ_WRN_005, SWREQ_SM_005, SWREQ_ODD_002.
      data active: type=boolean
      data severity: type=uint8
      data durationSec: type=float32
    SRI_TrackingHint  # SW requirements: SWREQ_ALG_004, SWREQ_SEN_004.
      7 x data:
        roiValid: type=boolean
        roiCenterX: type=uint32
        roiCenterY: type=uint32
        roiWidth: type=uint32
        roiHeight: type=uint32
        trackConfidence: type=float32
        lastDetectionId: type=uint32
    SRI_CameraStatus  # SW requirements: SWREQ_SEN_005, SWREQ_SEN_006, SWREQ_ODD_005, SWREQ_ODD_006.
      8 x data:
        statusValid: type=boolean
        statusTimestampMs: type=uint32
        dataValid: type=boolean
        blockageEstimateValid: type=boolean
        blockageLevel: type=float32
        degraded: type=boolean
        fovValid: type=boolean
        latencyMs: type=uint16
    SRI_InfraredStatus  # SW requirements: SWREQ_SEN_005, SWREQ_SEN_006, SWREQ_ODD_006, SWREQ_SEN_007.
      11 x data:
        statusValid: type=boolean
        statusTimestampMs: type=uint32
        dataValid: type=boolean
        blockageEstimateValid: type=boolean
        blockageLevel: type=float32
        degraded: type=boolean
        fovValid: type=boolean
        calibrationValid: type=boolean
        contrastEstimateValid: type=boolean
        contrastAdequate: type=boolean
        latencyMs: type=uint16
    SRI_LidarScan  # SW requirements: SWREQ_SEN_002, SWREQ_SEN_004.
      9 x data:
        scanId: type=uint32
        scanTimestampMs: type=uint32
        pointCount: type=uint32
        nearestRangeM: type=float32
        nearestAzimuthDeg: type=float32
        nearestElevationDeg: type=float32
        meanIntensity: type=float32
        existenceProb: type=float32
        rangeStatus: type=uint8
    SRI_LidarStatus  # SW requirements: SWREQ_SEN_005, SWREQ_SEN_006, SWREQ_ODD_004, SWREQ_ODD_006.
      9 x data:
        statusValid: type=boolean
        statusTimestampMs: type=uint32
        dataValid: type=boolean
        blockageEstimateValid: type=boolean
        blockageLevel: type=float32
        degraded: type=boolean
        pointDensityOk: type=boolean
        fovValid: type=boolean
        latencyMs: type=uint16
    SRI_ObjectList  # SW requirements: SWREQ_SEN_004, SWREQ_ALG_001, SWREQ_SEN_007.
      14 x data:
        cycleId: type=uint32
        objectCount: type=uint16
        objectId: type=uint32
        posX_m: type=float32
        posY_m: type=float32
        posZ_m: type=float32
        velX_mps: type=float32
        velY_mps: type=float32
        yaw_deg: type=float32
        length_m: type=float32
        width_m: type=float32
        height_m: type=float32
        existenceProb: type=float32
        measTimestampMs: type=uint32
    SRI_PerceptionCapability  # SW requirements: SWREQ_SEN_005, SWREQ_ODD_001, SWREQ_ODD_003, SWREQ_SM_005, SWREQ_SEN_007.
      5 x data:
        statusValid: type=boolean
        detectionAvailable: type=boolean
        oddWithinLimits: type=boolean
        reasonCode: type=uint8
        statusTimestampMs: type=uint32
    SRI_ControlCommand  # SW requirements: SWREQ_SM_002, SWREQ_SM_003.
      data command: type=uint8
      data sequenceCounter: type=uint32
    SRI_SystemStatus  # SW requirements: SWREQ_SM_004, SWREQ_SM_005, SWREQ_ODD_002, SWREQ_SEN_007.
      4 x data:
        state: type=uint8
        detectionAvailable: type=boolean
        reasonCode: type=uint8
        statusTimestampMs: type=uint32
