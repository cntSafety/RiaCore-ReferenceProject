AUTOSAR XML (schema 00046)
package /PortInterfaces
  13 x sender receiver interface:
    SRI_LightLevel
      data illuminanceLux: type=float32
    SRI_RgbIn
      data rgbFrameId: type=uint32
      data rgbTimestampMs: type=uint32
    SRI_RGBFrameReady
      data rgbFrameId: type=sint32
      data rgbTimestampMs: type=uint32
    SRI_IRFrameReady
      data irFrameId: type=sint32
      data irTimestampMs: type=uint32
    SRI_AmbientTemp
      data temperatureDegC: type=float32
      data humidityPercent: type=float32
    SRI_FusedDataReady
      data fusedDataId: type=uint32
      data syncTimestampMs: type=uint32
    SRI_DetectionResult
      7 x data:
        tigerDetected: type=boolean
        confidence: type=float32
        bboxX: type=uint32
        bboxY: type=uint32
        bboxW: type=uint32
        bboxH: type=uint32
        timestampMs: type=uint32
    SRI_WarningCommand
      data active: type=boolean
      data severity: type=uint8
      data durationSec: type=float32
    SRI_TrackingHint
      7 x data:
        roiValid: type=boolean
        roiCenterX: type=uint32
        roiCenterY: type=uint32
        roiWidth: type=uint32
        roiHeight: type=uint32
        trackConfidence: type=float32
        lastDetectionId: type=uint32
    SRI_CameraStatus
      4 x data:
        blockageLevel: type=float32
        degraded: type=boolean
        fovValid: type=boolean
        latencyMs: type=uint16
    SRI_LidarScan
      9 x data:
        scanId: type=uint32
        scanTimestampMs: type=uint32
        pointCount: type=uint32
        nearestRangeM: type=float32
        nearestAzimuthDeg: type=float32
        nearestElevationDeg: type=float32
        meanIntensity: type=float32
        existenceProb: type=float32
        rangeStatus: type=uint8
    SRI_LidarStatus
      4 x data:
        blockageLevel: type=float32
        degraded: type=boolean
        pointDensityOk: type=boolean
        latencyMs: type=uint16
    SRI_ObjectList
      16 x data:
        cycleId: type=uint32
        objectCount: type=uint16
        objectId: type=uint32
        posX_m: type=float32
        posY_m: type=float32
        posZ_m: type=float32
        velX_mps: type=float32
        velY_mps: type=float32
        yaw_deg: type=float32
        length_m: type=float32
        width_m: type=float32
        height_m: type=float32
        classId: type=uint8
        classConfidence: type=float32
        existenceProb: type=float32
        measTimestampMs: type=uint32
