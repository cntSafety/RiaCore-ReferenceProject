AUTOSAR XML (schema 00046)
package /PortInterfaces
  9 x sender receiver interface:
    SRI_LightLevel
      data illuminanceLux: type=float32
    SRI_RgbIn
      data rgbFrameId: type=uint32
      data rgbTimestampMs: type=uint32
    SRI_RGBFrameReady
      data rgbFrameId: type=sint32
      data rgbTimestampMs: type=uint32
    SRI_IRFrameReady
      data irFrameId: type=sint32
      data irTimestampMs: type=uint32
    SRI_AmbientTemp
      data temperatureDegC: type=float32
      data humidityPercent: type=float32
    SRI_FusedDataReady
      data fusedDataId: type=uint32
      data syncTimestampMs: type=uint32
    SRI_DetectionResult
      7 x data:
        tigerDetected: type=boolean
        confidence: type=float32
        bboxX: type=uint32
        bboxY: type=uint32
        bboxW: type=uint32
        bboxH: type=uint32
        timestampMs: type=uint32
    SRI_WarningCommand
      data active: type=boolean
      data severity: type=uint8
      data durationSec: type=float32
    SRI_TrackingHint
      7 x data:
        roiValid: type=boolean
        roiCenterX: type=uint32
        roiCenterY: type=uint32
        roiWidth: type=uint32
        roiHeight: type=uint32
        trackConfidence: type=float32
        lastDetectionId: type=uint32
